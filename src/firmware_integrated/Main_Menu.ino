// Global Params
const int NUM_ITEMS = 5; // number of items in the list and also the number of screenshots and screenshots with QR codes (other screens)
const int NUM_CHILD_ITEMS = 3;
const int MAX_ITEM_LENGTH = 20; // maximum characters for the item name
int number_of_items = NUM_ITEMS;

// Keep Track of Menu, Screen, and Running Function
bool module_function_is_running = false;
int current_screen = 0;   // Menu definition is on Menu_List.h
int item_selected = 0;    // which item in the menu is selected
int parent_idx = -1;
int item_sel_previous;    // previous item - used in the menu screen to draw the item before the selected one
int item_sel_next;        // next item - used in the menu screen to draw next item after the selected one

// BUTTONS
int button_up_clicked = 0; // only perform action when button is clicked, and wait until another press
int button_down_clicked = 0; // same as above
int button_select_clicked = 0; // same as above
int button_back_clicked = 0; // same as above

char main_menu[NUM_ITEMS][MAX_ITEM_LENGTH] = {
  { "IR Module" },
  { "NFC" },
  { "WiFi Tools" },
  { "Micro SD" },
  { "Bluetooth" }
};

char child_menu[NUM_ITEMS][NUM_CHILD_ITEMS][MAX_ITEM_LENGTH] = {
  {"Read IR", "Send IR", "List IR Cmd"},    // IR Menus
  {"Read NFC", "Write NFC", "List NFC"},    // NFC Menus
  {"Scan AP", "Sniff Traffic", "Deauth WiFi"},  // WiFi Menus
  {"Read File", "Format Storage", "Info"},   // Storage Menus
  {"Receive", "Send", "Info"}      // Other Menus
};


// 'microsd', 16x16px
const unsigned char bitmap_icon_microsd [] PROGMEM = {
	0x00, 0x00, 0x00, 0x00, 0x07, 0xf0, 0x08, 0x08, 0x0a, 0xa8, 0x0a, 0xa8, 0x0a, 0xa8, 0x10, 0x28, 
	0x10, 0x08, 0x10, 0x08, 0x10, 0x08, 0x10, 0x08, 0x10, 0x08, 0x0f, 0xf0, 0x00, 0x00, 0x00, 0x00
};
// 'wifi', 16x16px
const unsigned char bitmap_icon_wifi [] PROGMEM = {
	0x00, 0x00, 0x00, 0x00, 0x00, 0x00, 0x07, 0xe0, 0x18, 0x18, 0x20, 0x04, 0x40, 0x02, 0x07, 0xe0, 
	0x08, 0x10, 0x10, 0x08, 0x03, 0xc0, 0x04, 0x20, 0x01, 0x80, 0x01, 0x80, 0x00, 0x00, 0x00, 0x00
};
// 'nfc', 16x16px
const unsigned char bitmap_icon_nfc [] PROGMEM = {
	0x00, 0x00, 0x00, 0x30, 0x0c, 0x18, 0x0a, 0x08, 0x09, 0x08, 0x08, 0x88, 0x08, 0x48, 0x0a, 0x28, 
	0x09, 0x08, 0x08, 0x88, 0x08, 0x48, 0x08, 0x28, 0x08, 0x18, 0x0c, 0x08, 0x06, 0x00, 0x00, 0x00
};
// 'icon_infrared', 16x16px
const unsigned char bitmap_icon_infrared [] PROGMEM = {
	0x00, 0x00, 0x00, 0x00, 0x18, 0x20, 0x18, 0x90, 0x18, 0x48, 0x19, 0x28, 0x1c, 0xa8, 0x1e, 0xa8, 
	0x1c, 0xa8, 0x19, 0x28, 0x18, 0x48, 0x18, 0x90, 0x18, 0x20, 0x00, 0x00, 0x00, 0x00, 0x00, 0x00
};
// 'icon_ble', 16x16px
const unsigned char bitmap_icon_ble [] PROGMEM = {
	0x00, 0x00, 0x01, 0x80, 0x01, 0x40, 0x01, 0x20, 0x11, 0x10, 0x09, 0x10, 0x05, 0x20, 0x03, 0xc0, 
	0x03, 0xc0, 0x05, 0x20, 0x09, 0x10, 0x11, 0x10, 0x01, 0x20, 0x01, 0x40, 0x01, 0x80, 0x00, 0x00
};
// 'icon_3dcube', 16x16px
const unsigned char bitmap_icon_3dcube [] PROGMEM = {
  0x00, 0x00, 0x01, 0x80, 0x07, 0x60, 0x19, 0x18, 0x61, 0x06, 0x51, 0x0a, 0x45, 0xa2, 0x41, 0x02, 
  0x45, 0x22, 0x41, 0x02, 0x45, 0xa2, 0x51, 0x0a, 0x61, 0x06, 0x19, 0x18, 0x07, 0x60, 0x01, 0x80
};
// 'icon_battery', 16x16px
const unsigned char bitmap_icon_battery [] PROGMEM = {
  0x00, 0x00, 0x00, 0x00, 0x00, 0x00, 0x00, 0x00, 0x3f, 0xf8, 0x40, 0x04, 0x5b, 0x66, 0x5b, 0x66, 
  0x5b, 0x66, 0x40, 0x04, 0x3f, 0xf8, 0x00, 0x00, 0x00, 0x00, 0x00, 0x00, 0x00, 0x00, 0x00, 0x00
};
// 'icon_dashboard', 16x16px
const unsigned char bitmap_icon_dashboard [] PROGMEM = {
  0x07, 0xe0, 0x18, 0x18, 0x21, 0x24, 0x50, 0x02, 0x48, 0x0a, 0x84, 0x01, 0x83, 0x81, 0xa2, 0x45, 
  0x82, 0x41, 0x81, 0x81, 0xa0, 0x05, 0x40, 0x02, 0x4b, 0xd2, 0x23, 0xc4, 0x18, 0x18, 0x07, 0xe0
};
// 'icon_fireworks', 16x16px
const unsigned char bitmap_icon_fireworks [] PROGMEM = {
  0x00, 0x00, 0x00, 0x08, 0x00, 0x94, 0x10, 0x08, 0x10, 0x00, 0x6c, 0x00, 0x10, 0x10, 0x10, 0x10, 
  0x00, 0x00, 0x00, 0xc6, 0x00, 0x00, 0x00, 0x10, 0x04, 0x10, 0x0a, 0x00, 0x04, 0x00, 0x00, 0x00
};
// 'icon_gps_speed', 16x16px
const unsigned char bitmap_icon_gps_speed [] PROGMEM = {
  0x00, 0x00, 0x03, 0xf0, 0x00, 0x08, 0x01, 0xe4, 0x00, 0x12, 0x00, 0xca, 0x06, 0x2a, 0x07, 0x2a, 
  0x07, 0x8a, 0x07, 0xc2, 0x07, 0xc0, 0x0a, 0x00, 0x1f, 0x00, 0x20, 0x80, 0x7f, 0xc0, 0x00, 0x00
};
// 'icon_knob_over_oled', 16x16px
const unsigned char bitmap_icon_knob_over_oled [] PROGMEM = {
  0x00, 0x00, 0x1f, 0xf0, 0x13, 0x50, 0x1b, 0xb0, 0x11, 0x50, 0x1f, 0xf0, 0x03, 0x80, 0x01, 0x00, 
  0x00, 0x00, 0x09, 0x20, 0x49, 0x24, 0x20, 0x08, 0x00, 0x01, 0x80, 0x02, 0x00, 0x00, 0x00, 0x00
};
// 'icon_parksensor', 16x16px
const unsigned char bitmap_icon_parksensor [] PROGMEM = {
  0x00, 0x00, 0x00, 0x00, 0x00, 0x00, 0xfc, 0x00, 0x22, 0x00, 0x25, 0x00, 0xf9, 0x00, 0x00, 0x81, 
  0x0c, 0x85, 0x12, 0x95, 0xd2, 0x95, 0x0c, 0x05, 0x00, 0x01, 0x00, 0x00, 0x00, 0x00, 0x00, 0x00
};
// 'icon_turbo', 16x16px
const unsigned char bitmap_icon_turbo [] PROGMEM = {
  0x00, 0x0e, 0x07, 0xf1, 0x18, 0x01, 0x20, 0x01, 0x40, 0x01, 0x43, 0xf1, 0x84, 0x4e, 0x8a, 0xa0, 
  0x89, 0x22, 0x8a, 0xa2, 0x84, 0x42, 0x43, 0x84, 0x40, 0x04, 0x20, 0x08, 0x18, 0x30, 0x07, 0xc0
};

// Array of all bitmaps for convenience. (Total bytes used to store images in PROGMEM = 384)
const unsigned char* bitmap_icons[13] = {
  bitmap_icon_infrared,
  bitmap_icon_nfc,
  bitmap_icon_wifi,
  bitmap_icon_microsd,
  bitmap_icon_ble,
  bitmap_icon_3dcube,
  bitmap_icon_battery,
  bitmap_icon_dashboard,
  bitmap_icon_fireworks,
  bitmap_icon_gps_speed,
  bitmap_icon_knob_over_oled,
  bitmap_icon_parksensor,
  bitmap_icon_turbo
};

const unsigned char* bitmap_child_icons[5][5] = {
  {bitmap_icon_dashboard, bitmap_icon_3dcube, bitmap_icon_3dcube, bitmap_icon_3dcube, bitmap_icon_3dcube},
  {bitmap_icon_dashboard, bitmap_icon_3dcube, bitmap_icon_3dcube, bitmap_icon_3dcube, bitmap_icon_3dcube},
  {bitmap_icon_dashboard, bitmap_icon_3dcube, bitmap_icon_3dcube, bitmap_icon_3dcube, bitmap_icon_3dcube},
  {bitmap_icon_dashboard, bitmap_icon_3dcube, bitmap_icon_3dcube, bitmap_icon_3dcube, bitmap_icon_3dcube},
  {bitmap_icon_dashboard, bitmap_icon_3dcube, bitmap_icon_3dcube, bitmap_icon_3dcube, bitmap_icon_3dcube}
};

// 'scrollbar_background', 8x64px
const unsigned char bitmap_scrollbar_background [] PROGMEM = {
  0x00, 0x02, 0x00, 0x02, 0x00, 0x02, 0x00, 0x02, 0x00, 0x02, 0x00, 0x02, 0x00, 0x02, 0x00, 0x02, 
  0x00, 0x02, 0x00, 0x02, 0x00, 0x02, 0x00, 0x02, 0x00, 0x02, 0x00, 0x02, 0x00, 0x02, 0x00, 0x02, 
  0x00, 0x02, 0x00, 0x02, 0x00, 0x02, 0x00, 0x02, 0x00, 0x02, 0x00, 0x02, 0x00, 0x02, 0x00, 0x02, 
  0x00, 0x02, 0x00, 0x02, 0x00, 0x02, 0x00, 0x02, 0x00, 0x02, 0x00, 0x02, 0x00, 0x02, 0x00, 0x00
};

// 'item_sel_outline', 128x21px
const unsigned char bitmap_item_sel_outline [] PROGMEM = {
  0x1f, 0xff, 0xff, 0xff, 0xff, 0xff, 0xff, 0xff, 0xff, 0xff, 0xff, 0xff, 0xff, 0xff, 0xff, 0xc0, 
  0x20, 0x00, 0x00, 0x00, 0x00, 0x00, 0x00, 0x00, 0x00, 0x00, 0x00, 0x00, 0x00, 0x00, 0x00, 0x20, 
  0x40, 0x00, 0x00, 0x00, 0x00, 0x00, 0x00, 0x00, 0x00, 0x00, 0x00, 0x00, 0x00, 0x00, 0x00, 0x30, 
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  0x1f, 0xff, 0xff, 0xff, 0xff, 0xff, 0xff, 0xff, 0xff, 0xff, 0xff, 0xff, 0xff, 0xff, 0xff, 0xc0
};

char menu_items [NUM_ITEMS][MAX_ITEM_LENGTH] = {  // array with item names
  { "IR Module" }, 
  { "NFC" }, 
  { "WiFi Tools" }, 
  { "Micro SD" }, 
  { "Bluetooth" }
};

// note - when changing the order of items above, make sure the other arrays referencing bitmaps
// also have the same order, for example array "bitmap_icons" for icons, and other arrays for screenshots and QR codes

void moduleDaemon(int parent, int child) {
  if (module_function_is_running == true) {
    if(parent == 0 && child == 0) { // read ir
      read_ir_signal();
    } else if (parent == 0 && child == 1) { // write ir
      send_ir_signal();
    } else if (parent == 0 && child == 2) { // list ir files
      File dir = SD.open("/infrared");
      list_ir_files(dir, 0);
    }
  } else {
    // do nothing
  }
}

void handleMenu() {
  // up and down buttons only work for the menu screen
  if ((digitalRead(BUTTON_UP_PIN) == LOW) && (button_up_clicked == 0)) { // up button clicked - jump to previous menu item
    item_selected = item_selected - 1; // select previous item
    button_up_clicked = 1; // set button to clicked to only perform the action once
    if (item_selected < 0) { // if first item was selected, jump to last item
      item_selected = number_of_items-1;
    }
  }
  else if ((digitalRead(BUTTON_DOWN_PIN) == LOW) && (button_down_clicked == 0)) { // down button clicked - jump to next menu item
    item_selected = item_selected + 1; // select next item
    button_down_clicked = 1; // set button to clicked to only perform the action once
    if (item_selected >= number_of_items) { // last item was selected, jump to first menu item
      item_selected = 0;
    }
  }

  if(current_screen == 0) {
    if ((digitalRead(BUTTON_SELECT_PIN) == LOW) && (button_select_clicked == 0)) {
      number_of_items = NUM_CHILD_ITEMS;
      current_screen = current_screen + 1;
      parent_idx = item_selected;
      button_select_clicked = 1;
      item_selected = 0;
    } else if ((digitalRead(BUTTON_BACK_PIN) == LOW) && (button_back_clicked == 0)) {
      current_screen = 0; // you are already at main menu
      button_back_clicked = 1;
      item_selected = 0;
    }
  } else if(current_screen == 1) {
    if ((digitalRead(BUTTON_SELECT_PIN) == LOW) && (button_select_clicked == 0)) {
      // Run Module
      module_function_is_running = true;
      current_screen = current_screen + 1;
      button_select_clicked = 1;
    } else if ((digitalRead(BUTTON_BACK_PIN) == LOW) && (button_back_clicked == 0)) {
      // back to main menu
      number_of_items = NUM_ITEMS;
      parent_idx = -1;
      item_selected = 0;
      current_screen = current_screen - 1;
      button_back_clicked = 1;
    }
  } else if(current_screen == 2) {
    if ((digitalRead(BUTTON_BACK_PIN) == LOW) && (button_back_clicked == 0)) {
      // back to child menu
      current_screen = current_screen - 1;
      module_function_is_running = false;
      button_back_clicked = 1;
    }
  }

  // debounce button
  if ((digitalRead(BUTTON_UP_PIN) == HIGH) && (button_up_clicked == 1)) { // unclick 
    button_up_clicked = 0;
  }
  if ((digitalRead(BUTTON_DOWN_PIN) == HIGH) && (button_down_clicked == 1)) { // unclick
    button_down_clicked = 0;
  }
  if ((digitalRead(BUTTON_SELECT_PIN) == HIGH) && (button_select_clicked == 1)) { // unclick
    button_select_clicked = 0;
  }
  if ((digitalRead(BUTTON_BACK_PIN) == HIGH) && (button_back_clicked == 1)) { // unclick
    button_back_clicked = 0;
  }

  // set correct values for the previous and next items
  item_sel_previous = item_selected - 1;
  if (item_sel_previous < 0) {
    item_sel_previous = number_of_items - 1;
  } // previous item would be below first = make it the last
  item_sel_next = item_selected + 1;  
  if (item_sel_next >= number_of_items) {
    item_sel_next = 0;
  } // next item would be after last = make it the first


  u8g.firstPage(); // required for page drawing mode for u8g library
  do {
    if (current_screen == 0) { // MENU SCREEN
      render_menu_list(number_of_items);
    } else if (current_screen == 1) {
      render_child_menu_list(parent_idx, number_of_items);
    } else if (current_screen == 2) {
      render_running_screen();
    }
  } while ( u8g.nextPage() ); // required for page drawing mode with u8g library



  // Daemon
  moduleDaemon(parent_idx, item_selected);
}

void render_menu_list(int num_items) {
  // selected item background
    u8g.setFlipMode(0);
    u8g.drawBitmap(0, 22, 128/8, 21, bitmap_item_sel_outline);

    // draw previous item as icon + label
    u8g.setFont(u8g_font_7x14);
    u8g.drawStr(25, 15, main_menu[item_sel_previous]); 
    u8g.drawBitmap( 4, 2, 16/8, 16, bitmap_icons[item_sel_previous]);          

    // draw selected item as icon + label in bold font
    u8g.setFont(u8g_font_7x14B);    
    u8g.drawStr(25, 15+20+2, main_menu[item_selected]);   
    u8g.drawBitmap( 4, 24, 16/8, 16, bitmap_icons[item_selected]);     

    // draw next item as icon + label
    u8g.setFont(u8g_font_7x14);     
    u8g.drawStr(25, 15+20+20+2+2, main_menu[item_sel_next]);   
    u8g.drawBitmap( 4, 46, 16/8, 16, bitmap_icons[item_sel_next]);        

    // draw scrollbar handle
    u8g.drawBox(125, 64/num_items * item_selected, 3, 64/num_items);   
}

void render_child_menu_list(int parent_idx, int num_items) {
  // selected item background
    u8g.drawBitmap(0, 22, 128/8, 21, bitmap_item_sel_outline);

    // draw previous item as icon + label
    u8g.setFont(u8g_font_7x14);
    u8g.drawStr(25, 15, child_menu[parent_idx][item_sel_previous]); 
    u8g.drawBitmap( 4, 2, 16/8, 16, bitmap_child_icons[parent_idx][item_sel_previous]);          

    // draw selected item as icon + label in bold font
    u8g.setFont(u8g_font_7x14B);    
    u8g.drawStr(25, 15+20+2, child_menu[parent_idx][item_selected]);   
    u8g.drawBitmap( 4, 24, 16/8, 16, bitmap_child_icons[parent_idx][item_selected]);     

    // draw next item as icon + label
    u8g.setFont(u8g_font_7x14);     
    u8g.drawStr(25, 15+20+20+2+2, child_menu[parent_idx][item_sel_next]);   
    u8g.drawBitmap( 4, 46, 16/8, 16, bitmap_child_icons[parent_idx][item_sel_next]);        

    // draw scrollbar handle
    u8g.drawBox(125, 64/num_items * item_selected, 3, 64/num_items);   
}

void render_running_screen() {
  u8g.setFont(u8g_font_7x14B);
  u8g.drawStr(0, 15, "running:"); 
}